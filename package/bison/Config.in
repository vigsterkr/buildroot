## package/bison/Config.in
```kconfig
config BR2_PACKAGE_BISON
	bool "bison"
	default n
	help
	  General-purpose parser generator that converts a 
	  grammar description for an LALR context-free grammar into a C 
	  program to parse that grammar.

	  http://www.gnu.org/software/bison/

config BR2_PACKAGE_BISON_YACC
	bool "yacc compat"
	default y
	depends on BR2_PACKAGE_BISON
	help
	  Enable yacc compatibility.

	  If you enable this option, then bison will be built with yacc
	  compatibility, including liby.
```

## package/dm/Config.in
```kconfig
config BR2_PACKAGE_DM
	bool "dm"
	default n
	help
	  The Device-mapper is a new component of the linux kernel that
	  supports logical volume management. It is required by LVM2 and EVMS.

	  Note: For dm _you_ need to turn on LARGEFILE support.

	  http://sources.redhat.com/dm/
```

## package/e2fsprogs/Config.in
```kconfig
config BR2_PACKAGE_E2FSPROGS
	bool "e2fsprogs"
	default n
	help
	  The EXT2 file system utilities and libraries

config BR2_PACKAGE_E2FSPROGS_LIBS
	bool "e2fsprogs-libs"
	default n
	help
	  The EXT2 file system libraries, without the utilities.
```

## package/epic4/Config.in
```kconfig
config BR2_PACKAGE_EPIC4
	bool "epic4"
	default n
	help
	  EPIC is an irc client project.

	  http://www.epicsol.org/
```

## package/gnupg/Config.in
```kconfig
config BR2_PACKAGE_GNUPG
	bool "gpg"
	default n
	help
	  GNU Privacy Guard

	  http://gnupg.org/
```

## package/gpm/Config.in
```kconfig
config BR2_PACKAGE_GPM
	bool "gpm"
	default n
	help
	  gpm means general purpose mouse and is the mouse support
	  for linux in the console.

	  http://unix.schottelius.org/gpm/
```

## package/iproute2/Config.in
```kconfig
config BR2_PACKAGE_IPROUTE2
	bool "iproute2"
	default n
#	depends on rint()
	help
	  Kernel routing and traffic control utilities.  Provides things 
	  like ip and tc.

	  http://developer.osdl.org/dev/iproute2/
```

## package/libdspbridge/Config.in
```kconfig
config BR2_PACKAGE_LIBDSPBRIDGE
	bool "libdspbridge"
	default n
	help
	  Library to dynamically load DLLs for the DSP. 
```

## package/lzma/Config.in
```kconfig
config BR2_PACKAGE_LZMA_TARGET
	bool "Install lzma for the target system"
	default n
	select BR2_GCC_CROSS_CXX
	help
	  lzma utils on the target

	  http://tukaani.org/lzma/

choice
	prompt "version"
	depends on BR2_PACKAGE_LZMA_TARGET || BR2_PACKAGE_LZMA_HOST
	default BR2_PACKAGE_LZMA_VERSION_git

config BR2_PACKAGE_LZMA_VERSION_release
	depends on BR2_PACKAGE_LZMA_TARGET || BR2_PACKAGE_LZMA_HOST
	bool "release"

config BR2_PACKAGE_LZMA_VERSION_git
	depends on BR2_PACKAGE_LZMA_TARGET || BR2_PACKAGE_LZMA_HOST
	bool "git"
endchoice

config BR2_PACKAGE_LZMA_VERSION
	string
	depends on BR2_PACKAGE_LZMA_TARGET || BR2_PACKAGE_LZMA_HOST
	default "4.32.4" if BR2_PACKAGE_LZMA_VERSION_release
	default "HEAD" if BR2_PACKAGE_LZMA_VERSION_git

config BR2_PACKAGE_LZMA_TARGET_HEADERS
	bool "lzma headers in target"
	default n
	depends on BR2_PACKAGE_LZMA_TARGET
	help
	  Put headers files in the target.

config BR2_PACKAGE_LZMA_HOST
	bool "Install lzma for the host/build system"
	default n
	help
	  lzma utils on the host

	  http://tukaani.org/lzma/
```

## package/lzo_mini/Config.in
```kconfig
config BR2_PACKAGE_LZO_MINI
	bool "lzo_mini"
	default n
	help
	  Portable lossless data compression library written in ANSI C.

	  http://www.oberhumer.com/opensource/lzo/
```

## package/mc/Config.in
```kconfig
config BR2_PACKAGE_MC
	bool "mc"
	default n
	help
	  GNU Midnight Commander is a textmode file manager.

	  http://www.ibiblio.org/mc/

config BR2_PACKAGE_MC_EDIT
	bool "internal mcedit"
	depends on BR2_PACKAGE_MC
	default n
	help
	  Enable internal editor
```

## package/mutt/Config.in
```kconfig
config BR2_PACKAGE_MUTT
	bool "mutt"
	default n
	select BR2_PACKAGE_NCURSES
	depends on BR2_USE_WCHAR
	help
	  (BROKEN without wchar; FIXME!)
	  Mutt is a sophisticated text-based Mail User Agent (MUA)

	  http://www.mutt.org/
```

## package/nasm/Config.in
```kconfig
config BR2_PACKAGE_NASM
	bool "nasm"
	default n
	help
	  NASM - the famous Netwide Assembler.

	  http://www.nasm.us/
```

## package/readline/Config.in
```kconfig
#
config BR2_PACKAGE_READLINE
	bool "readline"
	default n
	select BR2_PACKAGE_NCURSES
	help
	    Enable GNU readline support?

config BR2_PACKAGE_READLINE_TARGET
	bool "readline for the target"
	depends on BR2_PACKAGE_READLINE
	help
	  Say yes here to install the readline libraries and headers
	  on the target.
```

## package/xorg/Config.in
```kconfig
config BR2_PACKAGE_XORG
	bool "X.org X Window System"
	default y if BR2_PACKAGE_XSERVER_xorg
	select BR2_PACKAGE_ZLIB
	select BR2_PACKAGE_LIBPNG
	select BR2_PACKAGE_EXPAT
	select BR2_PACKAGE_FONTCONFIG
	select BR2_PACKAGE_PKGCONFIG
	# see bug #1556
	select BR2_USE_WCHAR
	help
	  The official X Window system and server.

comment "X.org 6.8.2 X Window System disabled"
	depends on BR2_PACKAGE_TINYX||BR2_PACKAGE_XORG7
```

## target/device/BeagleBoard/Config.in
```kconfig
config BR2_TARGET_BEAGLE
	bool "Beagle Board"
	depends on BR2_arm
        select BR2_PACKAGE_LINUX
	default n
	help
	  Support for Beagle Board device
```

## target/powerpc/yaboot/Config.in
```kconfig
config BR2_TARGET_YABOOT
	bool "yaboot"
	default n
	depends on BR2_powerpc
	select BR2_PACKAGE_E2FSPROGS_LIBS
	help
	  The yaboot bootloader for new world powerpc systems.

config BR2_YABOOT_HAVE_MD5
	bool "md5 support"
	default n
	depends on BR2_TARGET_YABOOT
	help
	  Support both cleartext as well as md5 passwords.

config BR2_YABOOT_HAVE_COLORTEXT
	bool "color text"
	default n
	depends on BR2_TARGET_YABOOT
	help
	  Enable text color configurability:
	  the fgcolor= and bgcolor= config options

config BR2_YABOOT_HAVE_COLORMAP
	bool "colormap"
	default n
	depends on BR2_TARGET_YABOOT
	help
	  Enable colormap setup.
	  Required on PowerMacs for text coloring to work right.

config BR2_YABOOT_FS_XFS
	bool "xfs"
	default n
	depends on BR2_TARGET_YABOOT
	help
	  Support SGI's XFS filesystem.

config BR2_YABOOT_FS_REISERFS
	bool "reiserfs"
	default n
	depends on BR2_TARGET_YABOOT
	help
	  Support reiserfs filesystem.
```
